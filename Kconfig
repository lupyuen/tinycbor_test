## Kconfig
```kconfig
#
# For a description of the syntax of this configuration file,
# see the file kconfig-language.txt in the NuttX tools repository.
#

config EXAMPLES_TINYCBOR_TEST
	tristate "TinyCBOR Test App"
	default n
	---help---
		Enable the TinyCBOR Test App

if EXAMPLES_TINYCBOR_TEST

config EXAMPLES_TINYCBOR_TEST_PROGNAME
	string "Program name"
	default "tinycbor_test"
	---help---
		This is the name of the program that will be used when the NSH ELF
		program is installed.

config EXAMPLES_TINYCBOR_TEST_PRIORITY
	int "TinyCBOR Test App task priority"
	default 100

config EXAMPLES_TINYCBOR_TEST_STACKSIZE
	int "TinyCBOR Test App stack size"
	default DEFAULT_TASK_STACKSIZE

endif
```
